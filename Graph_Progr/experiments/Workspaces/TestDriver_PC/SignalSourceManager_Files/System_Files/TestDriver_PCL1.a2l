ASAP2_VERSION 1 41
/begin PROJECT TestDriver_PC "Generated by ETAS from Project TestDriver_PC"
/begin HEADER "" VERSION "000" PROJECT_NO ASD /end HEADER
/begin MODULE TestDriver_PC "Generated by ETAS ASCET7 from Project: TestDriver_PC"
/begin IF_DATA E_TARGET
 /begin SOURCE "Task0" 3 /* period */ 10 QP_BLOB 1 /end SOURCE
 /begin TP_BLOB /* programm id */ 1300250082 /* target id */ 7 0 2 0 /end TP_BLOB
/end IF_DATA
/begin MOD_PAR "" VERSION "000" ADDR_EPK 0x0 EPK "" SUPPLIER "ETAS GmbH" CUSTOMER "xxx" CUSTOMER_NO "000" USER "xxx" PHONE_NO "000" ECU "PC" CPU_TYPE "PCx86" NO_OF_INTERFACES 1 /end MOD_PAR
/begin MOD_COMMON "Common definitions" BYTE_ORDER MSB_LAST ALIGNMENT_BYTE 1 ALIGNMENT_WORD 2 ALIGNMENT_LONG 4 ALIGNMENT_FLOAT32_IEEE 4 ALIGNMENT_FLOAT64_IEEE 8 /end MOD_COMMON
/begin CHARACTERISTIC components.Driver.inGaspedPosition "" VALUE 0x4520A8 STANDARD_VALUE_R32 0.0 esdl_ident -3.4028234663852886E+38 3.4028234663852886E+38 /end CHARACTERISTIC
/begin CHARACTERISTIC components.Driver.inBreakpedPosition "" VALUE 0x4520A4 STANDARD_VALUE_R32 0.0 esdl_ident -3.4028234663852886E+38 3.4028234663852886E+38 /end CHARACTERISTIC
/begin CHARACTERISTIC components.Module.Component_instance.TrackSize "" VALUE 0x435120 STANDARD_VALUE_R32 0.0 esdl_ident -3.4028234663852886E+38 3.4028234663852886E+38 /end CHARACTERISTIC
/begin CHARACTERISTIC components.Module.Component_instance.EngineMomentum "" MAP 0x43518C STANDARD_MAP_R32R32R32 0.0 esdl_ident -3.4028234663852886E+38 3.4028234663852886E+38
 /begin AXIS_DESCR STD_AXIS NO_INPUT_QUANTITY esdl_ident 6 -3.4028234663852886E+38 3.4028234663852886E+38 /end AXIS_DESCR
 /begin AXIS_DESCR STD_AXIS NO_INPUT_QUANTITY esdl_ident 6 -3.4028234663852886E+38 3.4028234663852886E+38 /end AXIS_DESCR
/end CHARACTERISTIC
/begin CHARACTERISTIC components.Module.Component_instance.BrakeMomentum "" CURVE 0x435158 STANDARD_CURVE_R32R32 0.0 esdl_ident -3.4028234663852886E+38 3.4028234663852886E+38
 /begin AXIS_DESCR STD_AXIS NO_INPUT_QUANTITY esdl_ident 6 -3.4028234663852886E+38 3.4028234663852886E+38 /end AXIS_DESCR
/end CHARACTERISTIC
/begin CHARACTERISTIC components.Module.Component_instance.AirFriction "" CURVE 0x435124 STANDARD_CURVE_R32R32 0.0 esdl_ident -3.4028234663852886E+38 3.4028234663852886E+38
 /begin AXIS_DESCR STD_AXIS NO_INPUT_QUANTITY esdl_ident 6 -3.4028234663852886E+38 3.4028234663852886E+38 /end AXIS_DESCR
/end CHARACTERISTIC
/begin CHARACTERISTIC components.Module.Component_instance.Landscape "" CURVE 0x435250 STANDARD_CURVE_R32R32 0.0 esdl_ident -3.4028234663852886E+38 3.4028234663852886E+38
 /begin AXIS_DESCR STD_AXIS NO_INPUT_QUANTITY esdl_ident 20 -3.4028234663852886E+38 3.4028234663852886E+38 /end AXIS_DESCR
/end CHARACTERISTIC
/begin MEASUREMENT components.Driver.turnAccOn "" UBYTE esdl_ident 1 100.0 0 1 ECU_ADDRESS 0x4520A2 BIT_MASK 0x1 /end MEASUREMENT
/begin MEASUREMENT components.Driver.turnAccOff "" UBYTE esdl_ident 1 100.0 0 1 ECU_ADDRESS 0x4520A1 BIT_MASK 0x1 /end MEASUREMENT
/begin MEASUREMENT components.Driver.accState "" UBYTE esdl_ident 1 100.0 0 1 ECU_ADDRESS 0x4520A0 BIT_MASK 0x1 /end MEASUREMENT
/begin MEASUREMENT components.gaspedMessage.gaspedPosition "" FLOAT32_IEEE esdl_ident 1 100.0 -3.4028234663852886E+38 3.4028234663852886E+38 ECU_ADDRESS 0x4520AC /end MEASUREMENT
/begin MEASUREMENT components.breakpedMessage.breakpedPosition "" FLOAT32_IEEE esdl_ident 1 100.0 -3.4028234663852886E+38 3.4028234663852886E+38 ECU_ADDRESS 0x452098 /end MEASUREMENT
/begin MEASUREMENT components.Module.trackPosition "" FLOAT32_IEEE esdl_ident 1 100.0 -3.4028234663852886E+38 3.4028234663852886E+38 ECU_ADDRESS 0x4520CC /end MEASUREMENT
/begin MEASUREMENT components.Module.dh "" FLOAT32_IEEE esdl_ident 1 100.0 -3.4028234663852886E+38 3.4028234663852886E+38 ECU_ADDRESS 0x4520C0 /end MEASUREMENT
/begin MEASUREMENT components.Module.v "" FLOAT32_IEEE esdl_ident 1 100.0 -3.4028234663852886E+38 3.4028234663852886E+38 ECU_ADDRESS 0x4520D0 /end MEASUREMENT
/begin MEASUREMENT components.Module.totalDistance "" FLOAT32_IEEE esdl_ident 1 100.0 -3.4028234663852886E+38 3.4028234663852886E+38 ECU_ADDRESS 0x4520C8 /end MEASUREMENT
/begin MEASUREMENT components.Module.dtime "" FLOAT32_IEEE esdl_ident 1 100.0 -3.4028234663852886E+38 3.4028234663852886E+38 ECU_ADDRESS 0x4520C4 /end MEASUREMENT
/begin MEASUREMENT components.Module.Component_instance.s "" FLOAT32_IEEE esdl_ident 1 100.0 -3.4028234663852886E+38 3.4028234663852886E+38 ECU_ADDRESS 0x4520E4 /end MEASUREMENT
/begin MEASUREMENT components.Module.Component_instance.v "" FLOAT32_IEEE esdl_ident 1 100.0 -3.4028234663852886E+38 3.4028234663852886E+38 ECU_ADDRESS 0x4520E8 /end MEASUREMENT
/begin MEASUREMENT components.Module.Component_instance.ds "" FLOAT32_IEEE esdl_ident 1 100.0 -3.4028234663852886E+38 3.4028234663852886E+38 ECU_ADDRESS 0x4520D8 /end MEASUREMENT
/begin MEASUREMENT components.Module.Component_instance.h "" FLOAT32_IEEE esdl_ident 1 100.0 -3.4028234663852886E+38 3.4028234663852886E+38 ECU_ADDRESS 0x4520DC /end MEASUREMENT
/begin MEASUREMENT components.Module.Component_instance.dh "" FLOAT32_IEEE esdl_ident 1 100.0 -3.4028234663852886E+38 3.4028234663852886E+38 ECU_ADDRESS 0x4520D4 /end MEASUREMENT
/begin MEASUREMENT components.Module.Component_instance.momentum "" FLOAT32_IEEE esdl_ident 1 100.0 -3.4028234663852886E+38 3.4028234663852886E+38 ECU_ADDRESS 0x4520E0 /end MEASUREMENT
/begin MEASUREMENT components.ContinousTrack.totalDistance "" FLOAT32_IEEE esdl_ident 1 100.0 -3.4028234663852886E+38 3.4028234663852886E+38 ECU_ADDRESS 0x45209C /end MEASUREMENT
/begin COMPU_METHOD esdl_ident "" RAT_FUNC /* format */ "%12.4" /* unit */ "" /* coeffs */ COEFFS 0 1 0 0 0 1 /end COMPU_METHOD
/begin FUNCTION TestDriver_PC ""
 /begin SUB_FUNCTION components.DeltaTimeService components.Driver components.Module components.ContinousTrack /end SUB_FUNCTION
/end FUNCTION
/begin FUNCTION components.DeltaTimeService "" /end FUNCTION
/begin FUNCTION components.Driver ""
 /begin DEF_CHARACTERISTIC components.Driver.inGaspedPosition components.Driver.inBreakpedPosition /end DEF_CHARACTERISTIC
 /begin OUT_MEASUREMENT components.breakpedMessage.breakpedPosition components.gaspedMessage.gaspedPosition /end OUT_MEASUREMENT
 /begin LOC_MEASUREMENT components.Driver.accState components.Driver.turnAccOff components.Driver.turnAccOn /end LOC_MEASUREMENT
/end FUNCTION
/begin FUNCTION components.Module ""
 /begin IN_MEASUREMENT components.breakpedMessage.breakpedPosition components.gaspedMessage.gaspedPosition /end IN_MEASUREMENT
 /begin LOC_MEASUREMENT components.Module.dh components.Module.dtime components.Module.totalDistance components.Module.trackPosition components.Module.v /end LOC_MEASUREMENT
 /begin SUB_FUNCTION components.Module.Component_instance /end SUB_FUNCTION
/end FUNCTION
/begin FUNCTION components.Module.Component_instance ""
 /begin DEF_CHARACTERISTIC components.Module.Component_instance.TrackSize components.Module.Component_instance.EngineMomentum components.Module.Component_instance.BrakeMomentum components.Module.Component_instance.AirFriction components.Module.Component_instance.Landscape /end DEF_CHARACTERISTIC
 /begin LOC_MEASUREMENT components.Module.Component_instance.dh components.Module.Component_instance.ds components.Module.Component_instance.h components.Module.Component_instance.momentum components.Module.Component_instance.s components.Module.Component_instance.v /end LOC_MEASUREMENT
/end FUNCTION
/begin FUNCTION components.ContinousTrack "" /begin LOC_MEASUREMENT components.ContinousTrack.totalDistance /end LOC_MEASUREMENT /end FUNCTION
/begin RECORD_LAYOUT STANDARD_VALUE_R32 FNC_VALUES 1 FLOAT32_IEEE COLUMN_DIR DIRECT /end RECORD_LAYOUT
/begin RECORD_LAYOUT STANDARD_MAP_R32R32R32 /* x axis size */ NO_AXIS_PTS_X 1 UWORD /* y axis size */ NO_AXIS_PTS_Y 2 UWORD /* x axis */ AXIS_PTS_X 3 FLOAT32_IEEE INDEX_INCR DIRECT /* y axis */ AXIS_PTS_Y 4 FLOAT32_IEEE INDEX_INCR DIRECT FNC_VALUES 5 FLOAT32_IEEE COLUMN_DIR DIRECT /end RECORD_LAYOUT
/begin RECORD_LAYOUT STANDARD_CURVE_R32R32 /* axis size */ NO_AXIS_PTS_X 1 UWORD /* axis */ AXIS_PTS_X 2 FLOAT32_IEEE INDEX_INCR DIRECT FNC_VALUES 3 FLOAT32_IEEE COLUMN_DIR DIRECT /end RECORD_LAYOUT
/begin GROUP TestDriver_PC "" ROOT
 /begin SUB_GROUP components.DeltaTimeService components.Driver components.gaspedMessage components.breakpedMessage components.Module components.ContinousTrack /end SUB_GROUP
/end GROUP
/begin GROUP components.DeltaTimeService "" /end GROUP
/begin GROUP components.Driver ""
 /begin REF_CHARACTERISTIC components.Driver.inGaspedPosition components.Driver.inBreakpedPosition /end REF_CHARACTERISTIC
 /begin REF_MEASUREMENT components.Driver.accState components.Driver.turnAccOff components.Driver.turnAccOn /end REF_MEASUREMENT
/end GROUP
/begin GROUP components.gaspedMessage "" /begin REF_MEASUREMENT components.gaspedMessage.gaspedPosition /end REF_MEASUREMENT /end GROUP
/begin GROUP components.breakpedMessage "" /begin REF_MEASUREMENT components.breakpedMessage.breakpedPosition /end REF_MEASUREMENT /end GROUP
/begin GROUP components.Module ""
 /begin REF_MEASUREMENT components.Module.dh components.Module.dtime components.Module.totalDistance components.Module.trackPosition components.Module.v /end REF_MEASUREMENT
 /begin SUB_GROUP components.Module.Component_instance /end SUB_GROUP
/end GROUP
/begin GROUP components.Module.Component_instance ""
 /begin REF_CHARACTERISTIC components.Module.Component_instance.TrackSize components.Module.Component_instance.EngineMomentum components.Module.Component_instance.BrakeMomentum components.Module.Component_instance.AirFriction components.Module.Component_instance.Landscape /end REF_CHARACTERISTIC
 /begin REF_MEASUREMENT components.Module.Component_instance.dh components.Module.Component_instance.ds components.Module.Component_instance.h components.Module.Component_instance.momentum components.Module.Component_instance.s components.Module.Component_instance.v /end REF_MEASUREMENT
/end GROUP
/begin GROUP components.ContinousTrack "" /begin REF_MEASUREMENT components.ContinousTrack.totalDistance /end REF_MEASUREMENT /end GROUP
/end MODULE
/end PROJECT
