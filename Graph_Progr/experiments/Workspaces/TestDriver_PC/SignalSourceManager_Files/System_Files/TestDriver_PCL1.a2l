ASAP2_VERSION 1 41
/begin PROJECT TestDriver_PC "Generated by ETAS from Project TestDriver_PC"
/begin HEADER "" VERSION "000" PROJECT_NO ASD /end HEADER
/begin MODULE TestDriver_PC "Generated by ETAS ASCET7 from Project: TestDriver_PC"
/begin IF_DATA E_TARGET
 /begin SOURCE "Task0" 3 /* period */ 10 QP_BLOB 1 /end SOURCE
 /begin TP_BLOB /* programm id */ 671105470 /* target id */ 7 0 2 0 /end TP_BLOB
/end IF_DATA
/begin MOD_PAR "" VERSION "000" ADDR_EPK 0x0 EPK "" SUPPLIER "ETAS GmbH" CUSTOMER "xxx" CUSTOMER_NO "000" USER "xxx" PHONE_NO "000" ECU "PC" CPU_TYPE "PCx86" NO_OF_INTERFACES 1 /end MOD_PAR
/begin MOD_COMMON "Common definitions" BYTE_ORDER MSB_LAST ALIGNMENT_BYTE 1 ALIGNMENT_WORD 2 ALIGNMENT_LONG 4 ALIGNMENT_FLOAT32_IEEE 4 ALIGNMENT_FLOAT64_IEEE 8 /end MOD_COMMON
/begin CHARACTERISTIC components.Component.TrackSize "" VALUE 0x4340A0 STANDARD_VALUE_R32 0.0 esdl_ident -3.4028234663852886E+38 3.4028234663852886E+38 /end CHARACTERISTIC
/begin CHARACTERISTIC components.Component.c "" VALUE 0x4340A4 STANDARD_VALUE_R32 0.0 esdl_ident -3.4028234663852886E+38 3.4028234663852886E+38 /end CHARACTERISTIC
/begin CHARACTERISTIC components.Component.c_2 "" VALUE 0x4340A8 STANDARD_VALUE_R32 0.0 esdl_ident -3.4028234663852886E+38 3.4028234663852886E+38 /end CHARACTERISTIC
/begin CHARACTERISTIC components.Component.EngineMomentum "" MAP 0x434114 STANDARD_MAP_R32R32R32 0.0 esdl_ident -3.4028234663852886E+38 3.4028234663852886E+38
 /begin AXIS_DESCR STD_AXIS NO_INPUT_QUANTITY esdl_ident 6 -3.4028234663852886E+38 3.4028234663852886E+38 /end AXIS_DESCR
 /begin AXIS_DESCR STD_AXIS NO_INPUT_QUANTITY esdl_ident 6 -3.4028234663852886E+38 3.4028234663852886E+38 /end AXIS_DESCR
/end CHARACTERISTIC
/begin CHARACTERISTIC components.Component.BrakeMomentum "" CURVE 0x4340E0 STANDARD_CURVE_R32R32 0.0 esdl_ident -3.4028234663852886E+38 3.4028234663852886E+38
 /begin AXIS_DESCR STD_AXIS NO_INPUT_QUANTITY esdl_ident 6 -3.4028234663852886E+38 3.4028234663852886E+38 /end AXIS_DESCR
/end CHARACTERISTIC
/begin CHARACTERISTIC components.Component.AirFriction "" CURVE 0x4340AC STANDARD_CURVE_R32R32 0.0 esdl_ident -3.4028234663852886E+38 3.4028234663852886E+38
 /begin AXIS_DESCR STD_AXIS NO_INPUT_QUANTITY esdl_ident 6 -3.4028234663852886E+38 3.4028234663852886E+38 /end AXIS_DESCR
/end CHARACTERISTIC
/begin CHARACTERISTIC components.Component.Landscape "" CURVE 0x4341D8 STANDARD_CURVE_R32R32 0.0 esdl_ident -3.4028234663852886E+38 3.4028234663852886E+38
 /begin AXIS_DESCR STD_AXIS NO_INPUT_QUANTITY esdl_ident 20 -3.4028234663852886E+38 3.4028234663852886E+38 /end AXIS_DESCR
/end CHARACTERISTIC
/begin MEASUREMENT components.Component.s "" FLOAT32_IEEE esdl_ident 1 100.0 -3.4028234663852886E+38 3.4028234663852886E+38 ECU_ADDRESS 0x451078 /end MEASUREMENT
/begin MEASUREMENT components.Component.v "" FLOAT32_IEEE esdl_ident 1 100.0 -3.4028234663852886E+38 3.4028234663852886E+38 ECU_ADDRESS 0x45107C /end MEASUREMENT
/begin MEASUREMENT components.Component.ds "" FLOAT32_IEEE esdl_ident 1 100.0 -3.4028234663852886E+38 3.4028234663852886E+38 ECU_ADDRESS 0x451068 /end MEASUREMENT
/begin MEASUREMENT components.Component.h "" FLOAT32_IEEE esdl_ident 1 100.0 -3.4028234663852886E+38 3.4028234663852886E+38 ECU_ADDRESS 0x451070 /end MEASUREMENT
/begin MEASUREMENT components.Component.dh "" FLOAT32_IEEE esdl_ident 1 100.0 -3.4028234663852886E+38 3.4028234663852886E+38 ECU_ADDRESS 0x451064 /end MEASUREMENT
/begin MEASUREMENT components.Component.v_2 "" FLOAT32_IEEE esdl_ident 1 100.0 -3.4028234663852886E+38 3.4028234663852886E+38 ECU_ADDRESS 0x451080 /end MEASUREMENT
/begin MEASUREMENT components.Component.dt_Renamed "" FLOAT32_IEEE esdl_ident 1 100.0 -3.4028234663852886E+38 3.4028234663852886E+38 ECU_ADDRESS 0x45106C /end MEASUREMENT
/begin MEASUREMENT components.Component.momentum "" FLOAT32_IEEE esdl_ident 1 100.0 -3.4028234663852886E+38 3.4028234663852886E+38 ECU_ADDRESS 0x451074 /end MEASUREMENT
/begin MEASUREMENT components.Component.v_3 "" FLOAT32_IEEE esdl_ident 1 100.0 -3.4028234663852886E+38 3.4028234663852886E+38 ECU_ADDRESS 0x451084 /end MEASUREMENT
/begin MEASUREMENT components.Component.breakposTest "" FLOAT32_IEEE esdl_ident 1 100.0 -3.4028234663852886E+38 3.4028234663852886E+38 ECU_ADDRESS 0x451060 /end MEASUREMENT
/begin MEASUREMENT components.gaspedMessage.gaspedPosition "" FLOAT32_IEEE esdl_ident 1 100.0 -3.4028234663852886E+38 3.4028234663852886E+38 ECU_ADDRESS 0x4510A0 /end MEASUREMENT
/begin COMPU_METHOD esdl_ident "" RAT_FUNC /* format */ "%12.4" /* unit */ "" /* coeffs */ COEFFS 0 1 0 0 0 1 /end COMPU_METHOD
/begin FUNCTION TestDriver_PC ""
 /begin SUB_FUNCTION components.DeltaTimeService components.Component components.Driver /end SUB_FUNCTION
/end FUNCTION
/begin FUNCTION components.DeltaTimeService "" /end FUNCTION
/begin FUNCTION components.Component ""
 /begin DEF_CHARACTERISTIC components.Component.TrackSize components.Component.c components.Component.c_2 components.Component.EngineMomentum components.Component.BrakeMomentum components.Component.AirFriction components.Component.Landscape /end DEF_CHARACTERISTIC
 /begin IN_MEASUREMENT components.gaspedMessage.gaspedPosition /end IN_MEASUREMENT
 /begin LOC_MEASUREMENT components.Component.breakposTest components.Component.dh components.Component.ds components.Component.dt_Renamed components.Component.h components.Component.momentum components.Component.s components.Component.v components.Component.v_2 components.Component.v_3 /end LOC_MEASUREMENT
/end FUNCTION
/begin FUNCTION components.Driver "" /begin OUT_MEASUREMENT components.gaspedMessage.gaspedPosition /end OUT_MEASUREMENT /end FUNCTION
/begin RECORD_LAYOUT STANDARD_VALUE_R32 FNC_VALUES 1 FLOAT32_IEEE COLUMN_DIR DIRECT /end RECORD_LAYOUT
/begin RECORD_LAYOUT STANDARD_MAP_R32R32R32 /* x axis size */ NO_AXIS_PTS_X 1 UWORD /* y axis size */ NO_AXIS_PTS_Y 2 UWORD /* x axis */ AXIS_PTS_X 3 FLOAT32_IEEE INDEX_INCR DIRECT /* y axis */ AXIS_PTS_Y 4 FLOAT32_IEEE INDEX_INCR DIRECT FNC_VALUES 5 FLOAT32_IEEE COLUMN_DIR DIRECT /end RECORD_LAYOUT
/begin RECORD_LAYOUT STANDARD_CURVE_R32R32 /* axis size */ NO_AXIS_PTS_X 1 UWORD /* axis */ AXIS_PTS_X 2 FLOAT32_IEEE INDEX_INCR DIRECT FNC_VALUES 3 FLOAT32_IEEE COLUMN_DIR DIRECT /end RECORD_LAYOUT
/begin GROUP TestDriver_PC "" ROOT
 /begin SUB_GROUP components.DeltaTimeService components.Component components.gaspedMessage components.Driver /end SUB_GROUP
/end GROUP
/begin GROUP components.DeltaTimeService "" /end GROUP
/begin GROUP components.Component ""
 /begin REF_CHARACTERISTIC components.Component.TrackSize components.Component.c components.Component.c_2 components.Component.EngineMomentum components.Component.BrakeMomentum components.Component.AirFriction components.Component.Landscape /end REF_CHARACTERISTIC
 /begin REF_MEASUREMENT components.Component.breakposTest components.Component.dh components.Component.ds components.Component.dt_Renamed components.Component.h components.Component.momentum components.Component.s components.Component.v components.Component.v_2 components.Component.v_3 /end REF_MEASUREMENT
/end GROUP
/begin GROUP components.gaspedMessage "" /begin REF_MEASUREMENT components.gaspedMessage.gaspedPosition /end REF_MEASUREMENT /end GROUP
/begin GROUP components.Driver "" /end GROUP
/end MODULE
/end PROJECT
