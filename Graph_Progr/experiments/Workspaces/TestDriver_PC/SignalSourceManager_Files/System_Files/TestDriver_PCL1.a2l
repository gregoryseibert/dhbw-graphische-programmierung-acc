ASAP2_VERSION 1 41
/begin PROJECT TestDriver_PC "Generated by ETAS from Project TestDriver_PC"
/begin HEADER "" VERSION "000" PROJECT_NO ASD /end HEADER
/begin MODULE TestDriver_PC "Generated by ETAS ASCET7 from Project: TestDriver_PC"
/begin IF_DATA E_TARGET
 /begin SOURCE "Task0" 3 /* period */ 10 QP_BLOB 1 /end SOURCE
 /begin TP_BLOB /* programm id */ 1300250594 /* target id */ 7 0 2 0 /end TP_BLOB
/end IF_DATA
/begin MOD_PAR "" VERSION "000" ADDR_EPK 0x0 EPK "" SUPPLIER "ETAS GmbH" CUSTOMER "xxx" CUSTOMER_NO "000" USER "xxx" PHONE_NO "000" ECU "PC" CPU_TYPE "PCx86" NO_OF_INTERFACES 1 /end MOD_PAR
/begin MOD_COMMON "Common definitions" BYTE_ORDER MSB_LAST ALIGNMENT_BYTE 1 ALIGNMENT_WORD 2 ALIGNMENT_LONG 4 ALIGNMENT_FLOAT32_IEEE 4 ALIGNMENT_FLOAT64_IEEE 8 /end MOD_COMMON
/begin CHARACTERISTIC components.Driver.inGaspedPosition "" VALUE 0x4530E4 STANDARD_VALUE_R32 0.0 esdl_ident -3.4028234663852886E+38 3.4028234663852886E+38 /end CHARACTERISTIC
/begin CHARACTERISTIC components.Driver.inBreakpedPosition "" VALUE 0x4530E0 STANDARD_VALUE_R32 0.0 esdl_ident -3.4028234663852886E+38 3.4028234663852886E+38 /end CHARACTERISTIC
/begin CHARACTERISTIC components.Driver.accIsActive "" VALUE 0x4530E8 STANDARD_VALUE_U8 0.0 esdl_ident 0 1 BIT_MASK 0x1 /end CHARACTERISTIC
/begin CHARACTERISTIC components.Driver.accTargetSpeed "" VALUE 0x4530DC STANDARD_VALUE_R32 0.0 esdl_ident -3.4028234663852886E+38 3.4028234663852886E+38 /end CHARACTERISTIC
/begin CHARACTERISTIC components.Module.Component_instance.TrackSize "" VALUE 0x435260 STANDARD_VALUE_R32 0.0 esdl_ident -3.4028234663852886E+38 3.4028234663852886E+38 /end CHARACTERISTIC
/begin CHARACTERISTIC components.Module.Component_instance.EngineMomentum "" MAP 0x4352CC STANDARD_MAP_R32R32R32 0.0 esdl_ident -3.4028234663852886E+38 3.4028234663852886E+38
 /begin AXIS_DESCR STD_AXIS NO_INPUT_QUANTITY esdl_ident 6 -3.4028234663852886E+38 3.4028234663852886E+38 /end AXIS_DESCR
 /begin AXIS_DESCR STD_AXIS NO_INPUT_QUANTITY esdl_ident 6 -3.4028234663852886E+38 3.4028234663852886E+38 /end AXIS_DESCR
/end CHARACTERISTIC
/begin CHARACTERISTIC components.Module.Component_instance.BrakeMomentum "" CURVE 0x435298 STANDARD_CURVE_R32R32 0.0 esdl_ident -3.4028234663852886E+38 3.4028234663852886E+38
 /begin AXIS_DESCR STD_AXIS NO_INPUT_QUANTITY esdl_ident 6 -3.4028234663852886E+38 3.4028234663852886E+38 /end AXIS_DESCR
/end CHARACTERISTIC
/begin CHARACTERISTIC components.Module.Component_instance.AirFriction "" CURVE 0x435264 STANDARD_CURVE_R32R32 0.0 esdl_ident -3.4028234663852886E+38 3.4028234663852886E+38
 /begin AXIS_DESCR STD_AXIS NO_INPUT_QUANTITY esdl_ident 6 -3.4028234663852886E+38 3.4028234663852886E+38 /end AXIS_DESCR
/end CHARACTERISTIC
/begin CHARACTERISTIC components.Component.Landscape "" CURVE 0x4351A0 STANDARD_CURVE_R32R32 0.0 esdl_ident -3.4028234663852886E+38 3.4028234663852886E+38
 /begin AXIS_DESCR STD_AXIS NO_INPUT_QUANTITY esdl_ident 20 -3.4028234663852886E+38 3.4028234663852886E+38 /end AXIS_DESCR
/end CHARACTERISTIC
/begin MEASUREMENT components.Driver.turnAccOn "" UBYTE esdl_ident 1 100.0 0 1 ECU_ADDRESS 0x4530DB BIT_MASK 0x1 /end MEASUREMENT
/begin MEASUREMENT components.Driver.turnAccOff "" UBYTE esdl_ident 1 100.0 0 1 ECU_ADDRESS 0x4530DA BIT_MASK 0x1 /end MEASUREMENT
/begin MEASUREMENT components.Driver.accState "" UBYTE esdl_ident 1 100.0 0 1 ECU_ADDRESS 0x4530D8 BIT_MASK 0x1 /end MEASUREMENT
/begin MEASUREMENT components.Driver.newState "" UBYTE esdl_ident 1 100.0 0 1 ECU_ADDRESS 0x4530D9 BIT_MASK 0x1 /end MEASUREMENT
/begin MEASUREMENT components.gaspedMessage.gaspedPosition "" FLOAT32_IEEE esdl_ident 1 100.0 -3.4028234663852886E+38 3.4028234663852886E+38 ECU_ADDRESS 0x4530EC /end MEASUREMENT
/begin MEASUREMENT components.breakpedMessage.breakpedPosition "" FLOAT32_IEEE esdl_ident 1 100.0 -3.4028234663852886E+38 3.4028234663852886E+38 ECU_ADDRESS 0x4530D0 /end MEASUREMENT
/begin MEASUREMENT components.accStateChange.newState "" UBYTE esdl_ident 1 100.0 0 1 ECU_ADDRESS 0x4530CC BIT_MASK 0x1 /end MEASUREMENT
/begin MEASUREMENT components.accMessage.accIsActive "" UBYTE esdl_ident 1 100.0 0 1 ECU_ADDRESS 0x4530C4 BIT_MASK 0x1 /end MEASUREMENT
/begin MEASUREMENT components.accMessage.accTargetSpeed "" FLOAT32_IEEE esdl_ident 1 100.0 -3.4028234663852886E+38 3.4028234663852886E+38 ECU_ADDRESS 0x4530C8 /end MEASUREMENT
/begin MEASUREMENT components.Module.trackPosition "" FLOAT32_IEEE esdl_ident 1 100.0 -3.4028234663852886E+38 3.4028234663852886E+38 ECU_ADDRESS 0x45310C /end MEASUREMENT
/begin MEASUREMENT components.Module.dh "" FLOAT32_IEEE esdl_ident 1 100.0 -3.4028234663852886E+38 3.4028234663852886E+38 ECU_ADDRESS 0x453100 /end MEASUREMENT
/begin MEASUREMENT components.Module.v "" FLOAT32_IEEE esdl_ident 1 100.0 -3.4028234663852886E+38 3.4028234663852886E+38 ECU_ADDRESS 0x453110 /end MEASUREMENT
/begin MEASUREMENT components.Module.totalDistance "" FLOAT32_IEEE esdl_ident 1 100.0 -3.4028234663852886E+38 3.4028234663852886E+38 ECU_ADDRESS 0x453108 /end MEASUREMENT
/begin MEASUREMENT components.Module.dtime "" FLOAT32_IEEE esdl_ident 1 100.0 -3.4028234663852886E+38 3.4028234663852886E+38 ECU_ADDRESS 0x453104 /end MEASUREMENT
/begin MEASUREMENT components.Module.Component_instance.s "" FLOAT32_IEEE esdl_ident 1 100.0 -3.4028234663852886E+38 3.4028234663852886E+38 ECU_ADDRESS 0x45314C /end MEASUREMENT
/begin MEASUREMENT components.Module.Component_instance.v "" FLOAT32_IEEE esdl_ident 1 100.0 -3.4028234663852886E+38 3.4028234663852886E+38 ECU_ADDRESS 0x453150 /end MEASUREMENT
/begin MEASUREMENT components.Module.Component_instance.ds "" FLOAT32_IEEE esdl_ident 1 100.0 -3.4028234663852886E+38 3.4028234663852886E+38 ECU_ADDRESS 0x453140 /end MEASUREMENT
/begin MEASUREMENT components.Module.Component_instance.h "" FLOAT32_IEEE esdl_ident 1 100.0 -3.4028234663852886E+38 3.4028234663852886E+38 ECU_ADDRESS 0x453144 /end MEASUREMENT
/begin MEASUREMENT components.Module.Component_instance.dh "" FLOAT32_IEEE esdl_ident 1 100.0 -3.4028234663852886E+38 3.4028234663852886E+38 ECU_ADDRESS 0x45313C /end MEASUREMENT
/begin MEASUREMENT components.Module.Component_instance.momentum "" FLOAT32_IEEE esdl_ident 1 100.0 -3.4028234663852886E+38 3.4028234663852886E+38 ECU_ADDRESS 0x453148 /end MEASUREMENT
/begin MEASUREMENT components.Module.ACC_instance.prevGaspedPosition "" FLOAT32_IEEE esdl_ident 1 100.0 -3.4028234663852886E+38 3.4028234663852886E+38 ECU_ADDRESS 0x453120 /end MEASUREMENT
/begin MEASUREMENT components.Module.ACC_instance.prevBrakepedPosition "" FLOAT32_IEEE esdl_ident 1 100.0 -3.4028234663852886E+38 3.4028234663852886E+38 ECU_ADDRESS 0x45311C /end MEASUREMENT
/begin MEASUREMENT components.Module.ACC_instance.accGaspedPosition "" FLOAT32_IEEE esdl_ident 1 100.0 -3.4028234663852886E+38 3.4028234663852886E+38 ECU_ADDRESS 0x453118 /end MEASUREMENT
/begin MEASUREMENT components.Module.ACC_instance.accBrakepedPosition "" FLOAT32_IEEE esdl_ident 1 100.0 -3.4028234663852886E+38 3.4028234663852886E+38 ECU_ADDRESS 0x453114 /end MEASUREMENT
/begin MEASUREMENT components.Module.ACC_instance.isActive "" UBYTE esdl_ident 1 100.0 0 1 ECU_ADDRESS 0x453124 BIT_MASK 0x1 /end MEASUREMENT
/begin MEASUREMENT components.Module.ACC_instance_3.prevGaspedPosition "" FLOAT32_IEEE esdl_ident 1 100.0 -3.4028234663852886E+38 3.4028234663852886E+38 ECU_ADDRESS 0x453134 /end MEASUREMENT
/begin MEASUREMENT components.Module.ACC_instance_3.prevBrakepedPosition "" FLOAT32_IEEE esdl_ident 1 100.0 -3.4028234663852886E+38 3.4028234663852886E+38 ECU_ADDRESS 0x453130 /end MEASUREMENT
/begin MEASUREMENT components.Module.ACC_instance_3.accGaspedPosition "" FLOAT32_IEEE esdl_ident 1 100.0 -3.4028234663852886E+38 3.4028234663852886E+38 ECU_ADDRESS 0x45312C /end MEASUREMENT
/begin MEASUREMENT components.Module.ACC_instance_3.accBrakepedPosition "" FLOAT32_IEEE esdl_ident 1 100.0 -3.4028234663852886E+38 3.4028234663852886E+38 ECU_ADDRESS 0x453128 /end MEASUREMENT
/begin MEASUREMENT components.Module.ACC_instance_3.isActive "" UBYTE esdl_ident 1 100.0 0 1 ECU_ADDRESS 0x453138 BIT_MASK 0x1 /end MEASUREMENT
/begin MEASUREMENT components.ContinuousTrack.totalDistance "" FLOAT32_IEEE esdl_ident 1 100.0 -3.4028234663852886E+38 3.4028234663852886E+38 ECU_ADDRESS 0x4530D4 /end MEASUREMENT
/begin COMPU_METHOD esdl_ident "" RAT_FUNC /* format */ "%12.4" /* unit */ "" /* coeffs */ COEFFS 0 1 0 0 0 1 /end COMPU_METHOD
/begin FUNCTION TestDriver_PC ""
 /begin SUB_FUNCTION components.DeltaTimeService components.Driver components.Module components.ContinuousTrack /end SUB_FUNCTION
/end FUNCTION
/begin FUNCTION components.DeltaTimeService "" /end FUNCTION
/begin FUNCTION components.Driver ""
 /begin DEF_CHARACTERISTIC components.Driver.inGaspedPosition components.Driver.inBreakpedPosition components.Driver.accIsActive components.Driver.accTargetSpeed /end DEF_CHARACTERISTIC
 /begin OUT_MEASUREMENT components.accMessage.accIsActive components.accMessage.accTargetSpeed components.accStateChange.newState components.breakpedMessage.breakpedPosition components.gaspedMessage.gaspedPosition /end OUT_MEASUREMENT
 /begin LOC_MEASUREMENT components.Driver.accState components.Driver.newState components.Driver.turnAccOff components.Driver.turnAccOn /end LOC_MEASUREMENT
/end FUNCTION
/begin FUNCTION components.Module ""
 /begin IN_MEASUREMENT components.accMessage.accIsActive components.accMessage.accTargetSpeed components.breakpedMessage.breakpedPosition components.gaspedMessage.gaspedPosition /end IN_MEASUREMENT
 /begin OUT_MEASUREMENT components.accMessage.accIsActive /end OUT_MEASUREMENT
 /begin LOC_MEASUREMENT components.Module.dh components.Module.dtime components.Module.totalDistance components.Module.trackPosition components.Module.v /end LOC_MEASUREMENT
 /begin SUB_FUNCTION components.Module.Component_instance components.Module.ACC_instance components.Module.ACC_instance_3 /end SUB_FUNCTION
/end FUNCTION
/begin FUNCTION components.Module.Component_instance ""
 /begin DEF_CHARACTERISTIC components.Module.Component_instance.TrackSize components.Module.Component_instance.EngineMomentum components.Module.Component_instance.BrakeMomentum components.Module.Component_instance.AirFriction components.Component.Landscape /end DEF_CHARACTERISTIC
 /begin LOC_MEASUREMENT components.Module.Component_instance.dh components.Module.Component_instance.ds components.Module.Component_instance.h components.Module.Component_instance.momentum components.Module.Component_instance.s components.Module.Component_instance.v /end LOC_MEASUREMENT
/end FUNCTION
/begin FUNCTION components.Module.ACC_instance ""
 /begin LOC_MEASUREMENT components.Module.ACC_instance.accBrakepedPosition components.Module.ACC_instance.accGaspedPosition components.Module.ACC_instance.isActive components.Module.ACC_instance.prevBrakepedPosition components.Module.ACC_instance.prevGaspedPosition /end LOC_MEASUREMENT
/end FUNCTION
/begin FUNCTION components.Module.ACC_instance_3 ""
 /begin LOC_MEASUREMENT components.Module.ACC_instance_3.accBrakepedPosition components.Module.ACC_instance_3.accGaspedPosition components.Module.ACC_instance_3.isActive components.Module.ACC_instance_3.prevBrakepedPosition components.Module.ACC_instance_3.prevGaspedPosition /end LOC_MEASUREMENT
/end FUNCTION
/begin FUNCTION components.ContinuousTrack "" /begin LOC_MEASUREMENT components.ContinuousTrack.totalDistance /end LOC_MEASUREMENT /end FUNCTION
/begin RECORD_LAYOUT STANDARD_VALUE_R32 FNC_VALUES 1 FLOAT32_IEEE COLUMN_DIR DIRECT /end RECORD_LAYOUT
/begin RECORD_LAYOUT STANDARD_VALUE_U8 FNC_VALUES 1 UBYTE COLUMN_DIR DIRECT /end RECORD_LAYOUT
/begin RECORD_LAYOUT STANDARD_MAP_R32R32R32 /* x axis size */ NO_AXIS_PTS_X 1 UWORD /* y axis size */ NO_AXIS_PTS_Y 2 UWORD /* x axis */ AXIS_PTS_X 3 FLOAT32_IEEE INDEX_INCR DIRECT /* y axis */ AXIS_PTS_Y 4 FLOAT32_IEEE INDEX_INCR DIRECT FNC_VALUES 5 FLOAT32_IEEE COLUMN_DIR DIRECT /end RECORD_LAYOUT
/begin RECORD_LAYOUT STANDARD_CURVE_R32R32 /* axis size */ NO_AXIS_PTS_X 1 UWORD /* axis */ AXIS_PTS_X 2 FLOAT32_IEEE INDEX_INCR DIRECT FNC_VALUES 3 FLOAT32_IEEE COLUMN_DIR DIRECT /end RECORD_LAYOUT
/begin GROUP TestDriver_PC "" ROOT
 /begin SUB_GROUP components.DeltaTimeService components.Driver components.gaspedMessage components.breakpedMessage components.accStateChange components.accMessage components.Module components.ContinuousTrack /end SUB_GROUP
/end GROUP
/begin GROUP components.DeltaTimeService "" /end GROUP
/begin GROUP components.Driver ""
 /begin REF_CHARACTERISTIC components.Driver.inGaspedPosition components.Driver.inBreakpedPosition components.Driver.accIsActive components.Driver.accTargetSpeed /end REF_CHARACTERISTIC
 /begin REF_MEASUREMENT components.Driver.accState components.Driver.newState components.Driver.turnAccOff components.Driver.turnAccOn /end REF_MEASUREMENT
/end GROUP
/begin GROUP components.gaspedMessage "" /begin REF_MEASUREMENT components.gaspedMessage.gaspedPosition /end REF_MEASUREMENT /end GROUP
/begin GROUP components.breakpedMessage "" /begin REF_MEASUREMENT components.breakpedMessage.breakpedPosition /end REF_MEASUREMENT /end GROUP
/begin GROUP components.accStateChange "" /begin REF_MEASUREMENT components.accStateChange.newState /end REF_MEASUREMENT /end GROUP
/begin GROUP components.accMessage ""
 /begin REF_MEASUREMENT components.accMessage.accIsActive components.accMessage.accTargetSpeed /end REF_MEASUREMENT
/end GROUP
/begin GROUP components.Module ""
 /begin REF_MEASUREMENT components.Module.dh components.Module.dtime components.Module.totalDistance components.Module.trackPosition components.Module.v /end REF_MEASUREMENT
 /begin SUB_GROUP components.Module.Component_instance components.Module.ACC_instance components.Module.ACC_instance_3 /end SUB_GROUP
/end GROUP
/begin GROUP components.Module.Component_instance ""
 /begin REF_CHARACTERISTIC components.Module.Component_instance.TrackSize components.Module.Component_instance.EngineMomentum components.Module.Component_instance.BrakeMomentum components.Module.Component_instance.AirFriction components.Component.Landscape /end REF_CHARACTERISTIC
 /begin REF_MEASUREMENT components.Module.Component_instance.dh components.Module.Component_instance.ds components.Module.Component_instance.h components.Module.Component_instance.momentum components.Module.Component_instance.s components.Module.Component_instance.v /end REF_MEASUREMENT
/end GROUP
/begin GROUP components.Module.ACC_instance ""
 /begin REF_MEASUREMENT components.Module.ACC_instance.accBrakepedPosition components.Module.ACC_instance.accGaspedPosition components.Module.ACC_instance.isActive components.Module.ACC_instance.prevBrakepedPosition components.Module.ACC_instance.prevGaspedPosition /end REF_MEASUREMENT
/end GROUP
/begin GROUP components.Module.ACC_instance_3 ""
 /begin REF_MEASUREMENT components.Module.ACC_instance_3.accBrakepedPosition components.Module.ACC_instance_3.accGaspedPosition components.Module.ACC_instance_3.isActive components.Module.ACC_instance_3.prevBrakepedPosition components.Module.ACC_instance_3.prevGaspedPosition /end REF_MEASUREMENT
/end GROUP
/begin GROUP components.ContinuousTrack "" /begin REF_MEASUREMENT components.ContinuousTrack.totalDistance /end REF_MEASUREMENT /end GROUP
/end MODULE
/end PROJECT
