ASAP2_VERSION 1 41
/begin PROJECT test_PC "Generated by ETAS from Project test_PC"
/begin HEADER "" VERSION "000" PROJECT_NO ASD /end HEADER
/begin MODULE test_PC "Generated by ETAS ASCET7 from Project: test_PC"
/begin IF_DATA E_TARGET
 /begin SOURCE "Task0" 3 /* period */ 10 QP_BLOB 1 /end SOURCE
 /begin TP_BLOB /* programm id */ 671101582 /* target id */ 7 0 2 0 /end TP_BLOB
/end IF_DATA
/begin MOD_PAR "" VERSION "000" ADDR_EPK 0x0 EPK "" SUPPLIER "ETAS GmbH" CUSTOMER "xxx" CUSTOMER_NO "000" USER "xxx" PHONE_NO "000" ECU "PC" CPU_TYPE "PCx86" NO_OF_INTERFACES 1 /end MOD_PAR
/begin MOD_COMMON "Common definitions" BYTE_ORDER MSB_LAST ALIGNMENT_BYTE 1 ALIGNMENT_WORD 2 ALIGNMENT_LONG 4 ALIGNMENT_FLOAT32_IEEE 4 ALIGNMENT_FLOAT64_IEEE 8 /end MOD_COMMON
/begin CHARACTERISTIC components.Component.TrackSize "" VALUE 0x434000 STANDARD_VALUE_R32 0.0 esdl_ident -3.4028234663852886E+38 3.4028234663852886E+38 /end CHARACTERISTIC
/begin CHARACTERISTIC components.Component.c "" VALUE 0x434004 STANDARD_VALUE_R32 0.0 esdl_ident -3.4028234663852886E+38 3.4028234663852886E+38 /end CHARACTERISTIC
/begin CHARACTERISTIC components.Component.c_2 "" VALUE 0x434008 STANDARD_VALUE_R32 0.0 esdl_ident -3.4028234663852886E+38 3.4028234663852886E+38 /end CHARACTERISTIC
/begin CHARACTERISTIC components.Component.EngineMomentum "" MAP 0x434074 STANDARD_MAP_R32R32R32 0.0 esdl_ident -3.4028234663852886E+38 3.4028234663852886E+38
 /begin AXIS_DESCR STD_AXIS NO_INPUT_QUANTITY esdl_ident 6 -3.4028234663852886E+38 3.4028234663852886E+38 /end AXIS_DESCR
 /begin AXIS_DESCR STD_AXIS NO_INPUT_QUANTITY esdl_ident 6 -3.4028234663852886E+38 3.4028234663852886E+38 /end AXIS_DESCR
/end CHARACTERISTIC
/begin CHARACTERISTIC components.Component.BrakeMomentum "" CURVE 0x434040 STANDARD_CURVE_R32R32 0.0 esdl_ident -3.4028234663852886E+38 3.4028234663852886E+38
 /begin AXIS_DESCR STD_AXIS NO_INPUT_QUANTITY esdl_ident 6 -3.4028234663852886E+38 3.4028234663852886E+38 /end AXIS_DESCR
/end CHARACTERISTIC
/begin CHARACTERISTIC components.Component.AirFriction "" CURVE 0x43400C STANDARD_CURVE_R32R32 0.0 esdl_ident -3.4028234663852886E+38 3.4028234663852886E+38
 /begin AXIS_DESCR STD_AXIS NO_INPUT_QUANTITY esdl_ident 6 -3.4028234663852886E+38 3.4028234663852886E+38 /end AXIS_DESCR
/end CHARACTERISTIC
/begin CHARACTERISTIC components.Component.Landscape "" CURVE 0x434138 STANDARD_CURVE_R32R32 0.0 esdl_ident -3.4028234663852886E+38 3.4028234663852886E+38
 /begin AXIS_DESCR STD_AXIS NO_INPUT_QUANTITY esdl_ident 20 -3.4028234663852886E+38 3.4028234663852886E+38 /end AXIS_DESCR
/end CHARACTERISTIC
/begin MEASUREMENT components.Component.s "" FLOAT32_IEEE esdl_ident 1 100.0 -3.4028234663852886E+38 3.4028234663852886E+38 ECU_ADDRESS 0x45103C /end MEASUREMENT
/begin MEASUREMENT components.Component.v "" FLOAT32_IEEE esdl_ident 1 100.0 -3.4028234663852886E+38 3.4028234663852886E+38 ECU_ADDRESS 0x451040 /end MEASUREMENT
/begin MEASUREMENT components.Component.ds "" FLOAT32_IEEE esdl_ident 1 100.0 -3.4028234663852886E+38 3.4028234663852886E+38 ECU_ADDRESS 0x451028 /end MEASUREMENT
/begin MEASUREMENT components.Component.h "" FLOAT32_IEEE esdl_ident 1 100.0 -3.4028234663852886E+38 3.4028234663852886E+38 ECU_ADDRESS 0x451034 /end MEASUREMENT
/begin MEASUREMENT components.Component.dh "" FLOAT32_IEEE esdl_ident 1 100.0 -3.4028234663852886E+38 3.4028234663852886E+38 ECU_ADDRESS 0x451024 /end MEASUREMENT
/begin MEASUREMENT components.Component.v_2 "" FLOAT32_IEEE esdl_ident 1 100.0 -3.4028234663852886E+38 3.4028234663852886E+38 ECU_ADDRESS 0x451044 /end MEASUREMENT
/begin MEASUREMENT components.Component.dt_Renamed "" FLOAT32_IEEE esdl_ident 1 100.0 -3.4028234663852886E+38 3.4028234663852886E+38 ECU_ADDRESS 0x45102C /end MEASUREMENT
/begin MEASUREMENT components.Component.momentum "" FLOAT32_IEEE esdl_ident 1 100.0 -3.4028234663852886E+38 3.4028234663852886E+38 ECU_ADDRESS 0x451038 /end MEASUREMENT
/begin MEASUREMENT components.Component.v_3 "" FLOAT32_IEEE esdl_ident 1 100.0 -3.4028234663852886E+38 3.4028234663852886E+38 ECU_ADDRESS 0x451048 /end MEASUREMENT
/begin MEASUREMENT components.Component.gaspedPosTEst "" FLOAT32_IEEE esdl_ident 1 100.0 -3.4028234663852886E+38 3.4028234663852886E+38 ECU_ADDRESS 0x451030 /end MEASUREMENT
/begin MEASUREMENT components.Component.breakposTest "" FLOAT32_IEEE esdl_ident 1 100.0 -3.4028234663852886E+38 3.4028234663852886E+38 ECU_ADDRESS 0x451020 /end MEASUREMENT
/begin COMPU_METHOD esdl_ident "" RAT_FUNC /* format */ "%12.4" /* unit */ "" /* coeffs */ COEFFS 0 1 0 0 0 1 /end COMPU_METHOD
/begin FUNCTION test_PC "" /begin SUB_FUNCTION components.Component components.DeltaTimeService /end SUB_FUNCTION /end FUNCTION
/begin FUNCTION components.Component ""
 /begin DEF_CHARACTERISTIC components.Component.TrackSize components.Component.c components.Component.c_2 components.Component.EngineMomentum components.Component.BrakeMomentum components.Component.AirFriction components.Component.Landscape /end DEF_CHARACTERISTIC
 /begin LOC_MEASUREMENT components.Component.breakposTest components.Component.dh components.Component.ds components.Component.dt_Renamed components.Component.gaspedPosTEst components.Component.h components.Component.momentum components.Component.s components.Component.v components.Component.v_2 components.Component.v_3 /end LOC_MEASUREMENT
/end FUNCTION
/begin FUNCTION components.DeltaTimeService "" /end FUNCTION
/begin RECORD_LAYOUT STANDARD_VALUE_R32 FNC_VALUES 1 FLOAT32_IEEE COLUMN_DIR DIRECT /end RECORD_LAYOUT
/begin RECORD_LAYOUT STANDARD_MAP_R32R32R32 /* x axis size */ NO_AXIS_PTS_X 1 UWORD /* y axis size */ NO_AXIS_PTS_Y 2 UWORD /* x axis */ AXIS_PTS_X 3 FLOAT32_IEEE INDEX_INCR DIRECT /* y axis */ AXIS_PTS_Y 4 FLOAT32_IEEE INDEX_INCR DIRECT FNC_VALUES 5 FLOAT32_IEEE COLUMN_DIR DIRECT /end RECORD_LAYOUT
/begin RECORD_LAYOUT STANDARD_CURVE_R32R32 /* axis size */ NO_AXIS_PTS_X 1 UWORD /* axis */ AXIS_PTS_X 2 FLOAT32_IEEE INDEX_INCR DIRECT FNC_VALUES 3 FLOAT32_IEEE COLUMN_DIR DIRECT /end RECORD_LAYOUT
/begin GROUP test_PC "" ROOT /begin SUB_GROUP components.Component components.DeltaTimeService /end SUB_GROUP /end GROUP
/begin GROUP components.Component ""
 /begin REF_CHARACTERISTIC components.Component.TrackSize components.Component.c components.Component.c_2 components.Component.EngineMomentum components.Component.BrakeMomentum components.Component.AirFriction components.Component.Landscape /end REF_CHARACTERISTIC
 /begin REF_MEASUREMENT components.Component.breakposTest components.Component.dh components.Component.ds components.Component.dt_Renamed components.Component.gaspedPosTEst components.Component.h components.Component.momentum components.Component.s components.Component.v components.Component.v_2 components.Component.v_3 /end REF_MEASUREMENT
/end GROUP
/begin GROUP components.DeltaTimeService "" /end GROUP
/end MODULE
/end PROJECT
